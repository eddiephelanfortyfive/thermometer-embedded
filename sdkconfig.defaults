## sdkconfig.defaults
```kconfig
# Task Watchdog Timer configuration
# Timeout is reconfigured at runtime by Watchdog::init() to 8 seconds
CONFIG_ESP_TASK_WDT_EN=y
CONFIG_ESP_TASK_WDT_INIT=y
CONFIG_ESP_TASK_WDT_TIMEOUT_S=8
CONFIG_ESP_TASK_WDT_PANIC=y
```
